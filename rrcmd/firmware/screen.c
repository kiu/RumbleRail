#include "screen.h"

#include "dir.h"
#include "midi.h"
#include "rrcmd.h"

#include "lib/u8glib/u8g.h"

u8g_t u8g;

static unsigned char icon_boot_bits[] U8G_PROGMEM = {
   0x00, 0x00, 0x00, 0x00, 0x00, 0x00, 0x00, 0x00, 0x00, 0x00, 0x00, 0x00,
   0x00, 0x00, 0x00, 0x00, 0x00, 0x00, 0x00, 0x00, 0x00, 0x00, 0x00, 0x00,
   0x00, 0x00, 0x00, 0x00, 0x00, 0x00, 0x00, 0x00, 0x00, 0x00, 0x00, 0x00,
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   0x00, 0x00, 0x00, 0x00, 0x00, 0x00, 0x00, 0x00, 0x00, 0x00, 0x00, 0x00 };

static unsigned char icon_arrow_bits[] U8G_PROGMEM = {
   0x00, 0x00, 0x00, 0x00, 0x00, 0x00, 0x00, 0x08, 0x00, 0x00, 0x00, 0x00,
   0x0c, 0x00, 0x00, 0x00, 0x00, 0x0e, 0x00, 0x00, 0x00, 0x00, 0x0f, 0x00,
   0x00, 0x00, 0x80, 0x0f, 0x00, 0x00, 0x00, 0xc0, 0x0f, 0x00, 0x00, 0x00,
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   0x0c, 0x00, 0x00, 0x00, 0x00, 0x08, 0x00, 0x00 };

static unsigned char icon_floppy_bits[] U8G_PROGMEM = {
   0xff, 0xff, 0xff, 0xff, 0x03, 0xff, 0xff, 0xff, 0xff, 0x0f, 0xff, 0xff,
   0xff, 0xff, 0x0f, 0xff, 0xff, 0xff, 0xff, 0x1f, 0x0f, 0xfc, 0x1f, 0x3e,
   0x7f, 0x0f, 0xfc, 0x1f, 0x3e, 0x7e, 0x0f, 0xfc, 0x1f, 0x3e, 0xfe, 0x0f,
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   0xff, 0xff, 0xff, 0xff, 0xff, 0xff, 0xff, 0xff };

static unsigned char icon_refresh_bits[] U8G_PROGMEM = {
   0x00, 0x00, 0xff, 0x00, 0x00, 0x00, 0xe0, 0xff, 0x07, 0x00, 0x00, 0xf8,
   0xff, 0x3f, 0x20, 0x00, 0xfe, 0xff, 0x7f, 0x38, 0x00, 0xff, 0xff, 0xff,
   0x39, 0x80, 0xff, 0xff, 0xff, 0x3f, 0xc0, 0xff, 0xff, 0xff, 0x3f, 0xe0,
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   0xff, 0x07, 0x00, 0x00, 0x00, 0xff, 0x00, 0x00 };

static unsigned char icon_sd_bits[] U8G_PROGMEM = {
   0x00, 0x00, 0x00, 0x00, 0x00, 0x00, 0x00, 0x00, 0x00, 0x00, 0x00, 0x00,
   0x00, 0x00, 0x00, 0xff, 0x07, 0xc0, 0xff, 0xff, 0xff, 0x07, 0xc0, 0xff,
   0xff, 0xff, 0xff, 0xff, 0xff, 0xff, 0xff, 0xff, 0xff, 0xff, 0xff, 0x03,
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   0x00, 0x00, 0x00, 0x00, 0x00, 0x00, 0x00, 0x00 };

int freeRam (void) {
	extern int __heap_start, *__brkval; 
	int v; 
	return (int) &v - (__brkval == 0 ? (int) &__heap_start : (int) __brkval); 
}

void screen_draw_header(char text[]) {
	u8g_DrawStr(&u8g, 4, 9, text);
	u8g_DrawLine(&u8g, 0, 10, 128, 10);
}

void screen_draw(uint8_t screen) {
	cbi(PORTA, PA3); // DSP CS

	u8g_FirstPage(&u8g);
        u8g_SetFont(&u8g, u8g_font_5x7);	
	do {

#ifdef DEBUG
	    	sprintf(out, "%05d", freeRam());
	  	u8g_DrawStr(&u8g, 97, 9, out);
#endif

		switch (screen) {
			case SCR_BOOT:
				//screen_draw_header("RumbleRail");
				u8g_DrawXBMP(&u8g, 3, 3, 124, 60, icon_boot_bits);
				break;
			case SCR_DISCOVER:
				screen_draw_header("Discover");
				u8g_DrawXBMP(&u8g, 14, 17, 40, 40, icon_floppy_bits);
				u8g_DrawXBMP(&u8g, 70, 17, 40, 40, icon_refresh_bits);
				break;
			case SCR_DISCOVER_RESULT:
				screen_draw_header("Discover");
				u8g_DrawXBMP(&u8g, 14, 17, 40, 40, icon_floppy_bits);
			        u8g_SetFont(&u8g, u8g_font_fub20);
				uint8_t count = get_floppy_count();
				sprintf(out, "%03d", count);
				u8g_DrawStr(&u8g, 70, 45, out);
			        u8g_SetFont(&u8g, u8g_font_5x7);
				break;
			case SCR_INSERT:
				screen_draw_header("Insert SD Card");
				u8g_DrawXBMP(&u8g, 14, 17, 40, 40, icon_sd_bits);
				u8g_DrawXBMP(&u8g, 70, 17, 40, 40, icon_arrow_bits);
				break;
			case SCR_SCANNING:
				screen_draw_header("Scanning");
				u8g_DrawXBMP(&u8g, 14, 17, 40, 40, icon_sd_bits);
				u8g_DrawXBMP(&u8g, 70, 17, 40, 40, icon_refresh_bits);
				break;
			case SCR_PLAY:
				sprintf(out, "Playing %s", dir_get_file_name(dir_get_file_idx()));
				screen_draw_header(out);
//				u8g_DrawXBMP(&u8g, 14, 17, 40, 40, icon_play_bits);
				u8g_DrawStr(&u8g, 22, 30, midi_get_row1());
				u8g_DrawStr(&u8g, 22, 40, midi_get_row2());
				u8g_DrawStr(&u8g, 22, 50, midi_get_row3());
				break;
			case SCR_SELECT:
				u8g_DrawLine(&u8g, 63, 0, 63, 64);
				uint8_t match = dir_get_file_idx();
				uint8_t x = 0;
				uint8_t y = 0;

				for (uint8_t i = 0; i < FILES_PER_PAGE; i++) {
					if (i < 8) {
						x = 3;
						y = 4 + 7 * (i + 1);
					} else {
						x = 66;
						y = 4 + 7 * (i - 8 + 1);
					}
					if (i == match) {						
						u8g_DrawBox(&u8g, x, y-6, 59, 6);
						u8g_SetColorIndex(&u8g, 0);
						u8g_DrawStr(&u8g, x, y, dir_get_file_name(i));
						u8g_SetColorIndex(&u8g, 1);
					} else {
						u8g_DrawStr(&u8g, x, y, dir_get_file_name(i));
					}

				}
				break;
		}
		
		u8g_DrawBox(&u8g, 0, 0, 128, 2);
		u8g_DrawBox(&u8g, 0, 62, 128, 64);
		u8g_DrawBox(&u8g, 0, 0, 2, 64);
		u8g_DrawBox(&u8g, 126, 0, 128, 64);
	} while ( u8g_NextPage(&u8g) );

	sbi(PORTA, PA3); // DSP CS
}

void screen_init() {
	u8g_InitHWSPI(&u8g, &u8g_dev_st7565_dogm128_hw_spi, PN(0, 3), PN(0, 5), PN(0, 4));
}

